#include <avr/io.h>
#include <avr/interrupt.h>
#include <avr/pgmspace.h>
#include <util/delay.h>
#include <stdint.h>
#include <stdio.h>
#include <string.h>

#include "uart.h"
#include "ff.h"
#include "diskio.h"
#include "vs10xx.h"
#include "spi.h"
//#include "menu.h"
#include "user_input.h"

#include "T6963c.h"

#define BUTTON_ENC (PINA & (1<<PA5))
#define BUTTON_TL  (PINA & (1<<PA6)) 
#define BUTTON_TR  (PINA & (1<<PA0))
#define BUTTON_M   (PINA & (1<<PA1))
#define BUTTON_BL  (PINA & (1<<PA2))
#define BUTTON_BR  (PINA & (1<<PA7))

void ui_periodic(void);
void mp3_play(char * filename);
void vs_printinfo(uint32_t file_len);

uint8_t g_ui_active = 0;

uint8_t g_vol = VS10xx_INITVOLUME;
uint8_t g_vol_change = 0;
/*---------------------------------------------------------*/
/* 100Hz timer interrupt generated by OC2                  */
/*---------------------------------------------------------*/
ISR(TIMER2_COMPA_vect)
{
	//Timer++;			/* Performance counter for this module */
	disk_timerproc();	/* Drive timer procedure of low level disk I/O module */
	
	if(g_ui_active) ui_periodic();
}

void ui_periodic()
{
	static uint8_t limit = 20;
	static uint8_t last_pa = 0;

	if(last_pa != PINA)
	{
		if(!BUTTON_TL)
		{
			T6963cPutStringXY(0, 15, "TL");
			
			g_vol+=2;
			g_vol_change = 1;
		}
		else if(!BUTTON_TR)
		{
			T6963cPutStringXY(0, 15, "TR");
			
			g_vol-=2;
			g_vol_change = 1;
		}
		else if(!BUTTON_M)
		{
			T6963cPutStringXY(0, 15, "M ");
		}
		else if(!BUTTON_BL)
		{
			T6963cPutStringXY(0, 15, "BL");
		}
		else if(!BUTTON_BR)
		{
			T6963cPutStringXY(0, 15, "BR");	
		}
		limit = 20;
		last_pa = PINA;
	}
	else
	{
		limit--;
	}	

}

void ui_init()
{
	g_ui_active = 1;
}

//char Lfname[_MAX_LFN+1];
char Lfname[48];
FATFS fatfs;
FIL fmp3;
uint8_t g_textbuffer[32];
uint8_t buffer1[32];
uint8_t buffer2[32];
FILINFO Finfo;

void fs_init()
{
	FRESULT res;

	Finfo.lfname = Lfname;
	Finfo.lfsize = sizeof(Lfname);

	res = f_mount(0, &fatfs);
	if (res) { uart_puts_P("f_mount failed\r\n"); return; }
	
	res = f_chdir("0:/music");
	if (res) { uart_puts_P("f_chdir failed\r\n"); return; }
}

void fs_test()
{
	FRESULT res;
	DIR dir;
	uint8_t line = 0;
	char *fn;
	uint16_t count = 0;

	
	res = f_opendir(&dir, ".");
	if (res) { uart_puts_P("f_opendir failed\r\n"); return; }

	for(;;) 
	{
		res = f_readdir(&dir, &Finfo);
		if ((res != FR_OK) || !Finfo.fname[0]) 
			break;
		
		fn = *Finfo.lfname ? Finfo.lfname : Finfo.fname;

		if (fn[0] == '.') continue;

		uart_puts(fn);
		
		if(Finfo.fattrib & AM_DIR)
			uart_puts_P("/");
		
		uart_puts_P("\r\n");

		//if(line <= 16)
		//	T6963cPutStringXY(0, line++, fn);

		
		//if(count++ > 20) break;
		
		if(strstr(fn, ".mp3"))
		{
			T6963cClear();
			T6963cPutStringXY(0, 0, fn);
			mp3_play(fn);
		}
	}
}

FRESULT mp3_fillbuffer(uint8_t *buffer, uint16_t len)
{
	uint16_t bread = 0;
	FRESULT res;
	
	res = f_read(&fmp3, buffer, len, &bread);     /* Read a chunk of src file */
   	if (res) {
   		uart_puts_P("f_read failed.\r\n");
   	}
   	if (!bread) {
   		uart_puts_P("f_read: EOF.\r\n");
   		return 1;
   	}
   	
   	return res;
}

#define ID3_COMPLETE_TAGS
uint8_t print_id3_tags(FIL *fd) 
{
    uint32_t fsize = f_size(fd);
    uint16_t bread = 0;
    uint8_t line = 4;
    uint8_t *buffer = buffer1;
       
    // ID3V1 tags are at the last 128 bytes of a MP3 file - seek to that position
    if (f_lseek(fd, fsize-128)) {
        return 1;
    }
   
    // read magic value of length 3 bytes, it should contain value "TAG"
    if (f_read(fd, buffer, 3, &bread)) {
        return 1;
    }

    // check for magic bytes
    if (strncmp(buffer, "TAG", 3))
    {
	    // not an error, but no tags are there
        return 1; 
   	}
   
    // if we arrive here, ID3V1 tags may exist
   
    // tag: title
    if (f_read(fd, buffer, 30, &bread)) {
        return 1;
    }
    buffer[20] = 0;
   	T6963cPutStringXY(0, line++, buffer);
   
    // tag: artist
    if (f_read(fd, buffer, 30, &bread)) {
        return 1;
    }
    buffer[20] = 0;
   	T6963cPutStringXY(0, line++, buffer);
   
#ifdef ID3_COMPLETE_TAGS   
    // tag: album
    if (f_read(fd, buffer, 30, &bread)) {
        return 1;
    }
    buffer[20] = 0;
   	T6963cPutStringXY(0, line++, buffer);

    // tag: year
    if (f_read(fd, buffer, 4, &bread)) {
        return 1;
    }
    buffer[4] = 0;
   	T6963cPutStringXY(0, line++, buffer);
/*
    // tag: comment
    if (f_read(fd, buffer, 30, &bread)) {
        return 1;
    }
    buffer[20] = 0;
   	T6963cPutStringXY(0, line++, buffer);

    // tag: genre
    if (f_read(fd, buffer, 1, &bread) ) {
        return 1;
    }
   	//T6963cPutStringXY(0, line++, buffer);
*/
#endif

    // set back fp pointer to start of file
    if (f_lseek(fd, 0)) {
        return 1;
    }

    return 0;
}

#define SCI_DECODE_TIME 0x04
#define SCI_AUDATA      0x05
#define SCI_HDAT0       0x08
#define SCI_HDAT1       0x09

void vs_printinfo(uint32_t file_len)
{
	static uint16_t bitrate_l1id3[16] = {
		0, 32, 54, 96, 128, 160, 192, 224, 256, 288, 320, 352, 384, 416, 448, 0
	};
	static uint16_t bitrate_l3[16] = {
		// Layer 3, ID=0,1,2
		0, 8, 16, 24, 32, 40, 48, 56, 64, 80, 96, 112, 128, 114, 160, 0
	};
	static uint16_t bitrate_l3id3[16] = {
		// Layer 3, ID=3 only!
		0, 32, 40, 48, 56, 64, 80, 96, 112, 128, 160, 192, 224, 256, 320, 0
	};
	static uint16_t bitrate_l2id3[16] = {
		// Layer 2, ID=3 only!
		0, 32, 48, 56, 64, 80, 96, 112, 128, 160, 192, 224, 256, 320, 384, 0
	};
	uint16_t reg, hdat0, hdat1;
	char *buffer = g_textbuffer;
	uint8_t line = 9;
	uint16_t kbit;
	uint8_t id, layer;	
	char *str;

	while(VS10xx_DREQ_STATUS == 0);		//Wait for DREQ to go high
	hdat1 = vs10xx_cntr_rd(SCI_HDAT1);
	while(VS10xx_DREQ_STATUS == 0);		//Wait for DREQ to go high
	hdat0 = vs10xx_cntr_rd(SCI_HDAT0);
	
	id    = (hdat1 >> 3) & 3;
	layer = 4-( (hdat1 >> 1) & 3);
	kbit  = hdat0 >> 12;
	
	if(layer==1 && id==3)
		kbit = bitrate_l1id3[kbit];
	else if(layer==3 && id==3)
		kbit = bitrate_l3id3[kbit];
	else if (layer==3)
		kbit = bitrate_l3[kbit];
	else if(layer==2 && id==3)
		kbit = bitrate_l2id3[kbit];
	else
		kbit = 0;
	
	sprintf(buffer, "id %u layer %u       ", id, layer);
   	T6963cPutStringXY(0, line++, buffer);


	while(VS10xx_DREQ_STATUS == 0);		//Wait for DREQ to go high
	reg = vs10xx_cntr_rd(SCI_DECODE_TIME);
	uint16_t s = file_len/125/kbit;
	sprintf(buffer, "%02u:%02u / %02u:%02u    ", reg/60, reg%60, s/60, s%60);
   	T6963cPutStringXY(0, line++, buffer);

	while(VS10xx_DREQ_STATUS == 0);		//Wait for DREQ to go high
	reg = vs10xx_cntr_rd(SCI_AUDATA);
	sprintf(buffer, "%5u Hz %s     ", reg&0xFFFE, (reg&0x01)?"STEREO":"MONO");
   	T6963cPutStringXY(0, line++, buffer);
   	
   	switch( (hdat0>>6)&3)
   	{
   		case 3: str="MONO"; // mono
   		case 2: str="2Chan"; // dual channel
   		case 1: str="J-STEREO"; // joint stereo
   		case 0: str="STEREO"; // stereo
   	}
	sprintf(buffer, "%3u kbit/s %s       ",kbit, str);
   	T6963cPutStringXY(0, line++, buffer);

	sprintf(buffer, "0x%04x %04x    ", hdat1, hdat0);
   	T6963cPutStringXY(0, line++, buffer);
	
}

void mp3_play(char * filename)
{
	uint16_t len = sizeof(buffer1);
	uint16_t pos = 0;
	uint8_t end = 0;
	uint8_t *buffer = buffer1;
	uint8_t nextbuf_full = 0;
	FRESULT res;
	uint16_t i;
	uint8_t last_button = BUTTON_ENC;
	//uint8_t state= 0;
	uint8_t count;
	uint32_t file_len;

	uart_puts_P("trying to open file...\r\n");
	res = f_open(&fmp3, filename, FA_OPEN_EXISTING | FA_READ);
	if(res) 
	{
		uart_puts_P("f_open failed.\r\n");
		return;
	}
	uart_puts_P("f_open succeeded!\r\n");
	
	file_len = f_size(&fmp3);
	
	print_id3_tags(&fmp3);
	
	while(VS10xx_DREQ_STATUS == 0);		//Wait for DREQ to go high
	// reset decode time 
	vs10xx_cntr_wr(SCI_DECODE_TIME, 0);


	mp3_fillbuffer(buffer, len);
		
	while(!end)
	{
		VS10xx_DESELECT_XDCS
	    for(i=0 ; i<len ; i++)
	    {
			while(VS10xx_DREQ_STATUS == 0);		//Wait for DREQ to go high

			spi_rw(buffer[i]);
			
/*			if(VS10xx_DREQ_STATUS==0) // FIFO full
			{
				if(!nextbuf_full) 
				{
					end = mp3_fillbuffer(nextbuffer, len);
					uart_putc('-');
				}
				nextbuf_full = 1;
				while(VS10xx_DREQ_STATUS == 0);		//Wait for DREQ to go high
			}
*/			
	    }
	    VS10xx_SELECT_XDCS
	    
    	end = mp3_fillbuffer(buffer, len);
	    
	    
	    if(last_button && (BUTTON_ENC == 0)) end=1;//state = 1;
	    last_button = BUTTON_ENC;
	    /*
	    if(state==1)
	    {
			// playback was canceled by user	
			vs10xx_cntr_wr(0, 0x0808);
			state = 2;
			spi_highspeed();
		}
		else if(state==2)
		{
			if((vs10xx_cntr_rd(0) & 0x0008) == 0) // SM_CANCEL bit is cleared
			end = 1;
			spi_highspeed();
	    }
	    */
	    
	    if(g_vol_change)
	    {
			vs10xx_cntr_wr(11,g_vol | (g_vol << 8));
			g_vol_change = 0;
		}
		
		if(!count--)
		{
			vs_printinfo(file_len);
			count = 50;
		}
	}
	
	spi_highspeed();
}

int main()
{
	uint16_t reg = 0x1234;
	uint8_t addr;

	// pull-ups on chip-select signals
	PORTB = 0xFF;
	
	DDRA = 0;
	PORTA = 0xFF;

	/* Start 100Hz system timer (TC2.OC) */
	OCR2A = F_CPU / 1024 / 100 - 1;
	//TCCR2 = 0b00001101;
	TCCR2A = (1<<WGM21);
	TCCR2B = (1<<CS22)|(1<<CS21)|(1<<CS20); // prescaler=1024
	TIMSK2 |= _BV(OCIE2A);
	
	_delay_ms(100);

	uart_init(UART_BAUD_SELECT(9600, F_CPU));
	sei();

	uart_puts_P("START\r\n");


	//Initialize
	//XOR mode, internal CG, Text and Graphic, Blinking Cursor
	T6963cInit(	T6963C_MODE_XOR | T6963C_CG_INTERNALROM,
				T6963C_TEXT_GRAPHIC | T6963C_CURSOR_BLINK );
	
	
	spi_init();
	vs10xx_init();
	
	encode_init();
	


	uart_puts_P("Hallo, Welt\r\n");
	
	for(addr = 0 ; addr<=0x0F ; addr++)
	{
		reg = vs10xx_cntr_rd(addr);
	
		sprintf(buffer1, "reg %2u: 0x%04x\r\n", addr, reg);
		uart_puts(buffer1);
	}
	
	spi_highspeed();
	
	//menu_start("0:/music");

	fs_init();
	
	ui_init();

	fs_test();
	

//	mp3_play("Trouble Man.mp3");
//	mp3_play("03 Big in Japan.mp3");
//	mp3_play("Imagine.mp3");



	while(1) {}
/*	
	while(1)
	{
		//asm volatile("nop");
	
		vs10xx_sinetest();

		
		uart_puts_P(".");
		
		_delay_ms(1000);
	}	
*/
	return 0;
}
